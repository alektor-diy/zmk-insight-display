## Kconfig
```kconfig
menuconfig ZMK_INSIGHT_DISPLAY
    bool "Insight display module"
    depends on ZMK_SPLIT && ZMK_SPLIT_BLE && ZMK_BLE
    select BT_GATT_CLIENT if !ZMK_SPLIT_ROLE_CENTRAL
    select BT_GATT_AUTO_DISCOVER_CCC if !ZMK_SPLIT_ROLE_CENTRAL
    select ZMK_SPLIT_BLE_CENTRAL_BATTERY_LEVEL_FETCHING if ZMK_SPLIT_ROLE_CENTRAL
    select LVGL_USE_LABEL if ZMK_DISPLAY
    select LV_USE_LABEL if ZMK_DISPLAY
    help
      Synchronize split-wide status for OLED displays, including support for
      displays attached only to the split peripheral side.

if ZMK_INSIGHT_DISPLAY

config LV_Z_VDB_SIZE
    default 32 if ZMK_DISPLAY

config ZMK_INSIGHT_DISPLAY_SYNC_VERSION
    int
    default 1

config ZMK_INSIGHT_DISPLAY_MAX_SERVICE_READ
    int "Max bytes accepted for insight display sync reads"
    default 32
    depends on !ZMK_SPLIT_ROLE_CENTRAL
    help
      Internal guard for the sync payload size when a peripheral reads the
      central-side state snapshot.

config ZMK_INSIGHT_DISPLAY_BOOT_TEXT
    string "Boot text"
    default "INITIALIZING..."
    help
      Text shown centered on the OLED before representative state is ready.
      Leave the default for a generic startup message, or override it from
      your config to brand the keyboard.

endif
```

## dts/bindings/zmk,insight-display.yaml
```yaml
description: ZMK Insight display configuration

compatible: "zmk,insight-display"

properties:
  side:
    type: string
    required: true
    enum:
      - left
      - right
    description: Physical side for this firmware image.

  display:
    type: phandle
    required: false
    description: Optional local display device used by this half.

  layout:
    type: string
    required: false
    default: "128x32"
    enum:
      - 128x32
      - 128x64
    description: Layout template used when a local display is present.

  screen-mode:
    type: string
    required: false
    default: "single"
    enum:
      - single
      - paired
    description: >
      single shows both left and right battery values on one screen.
      paired shows only the local side battery value.
```
